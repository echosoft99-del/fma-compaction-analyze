 /*
=================================================================================
  مراقبة دمك التربة FMA - الإصدار الميداني النهائي
  Hardware : DOIT ESP32 DEVKIT V1
  Sensor   : MPU9250 / MPU6500 / MPU9255   (I2C  SDA=GPIO21  SCL=GPIO22)
  Regulator: HT7333-A  3.3V
  Charger  : TP4056  +  Li-ion 3.7 V
=================================================================================
  Arduino IDE 2.x:
  - Board: DOIT ESP32 DEVKIT V1
  - Partition Scheme: Huge APP
  - Required libraries:
      * لا توجد ملفات واجهة خارجية مطلوبة
=================================================================================
  المسارات :
    GET  /            -> واجهة الويب الأصلية مدمجة داخل الكود
    GET  /data        -> قراءة JSON من الحساس
    GET  /calibrate   -> إعادة المعايرة
    GET  /get-wifi    -> قراءة اسم الشبكة المحفوظة
    POST /set-wifi    -> تغيير الشبكة  (X-API-Key: FMA2024)
    POST /control     -> تحكم بالعداد  {"action":"start"/"stop"/"clear"}
    POST /reset-wifi  -> حذف شبكة Wi-Fi المحفوظة والعودة إلى AP
    POST /reboot      -> إعادة تشغيل الجهاز
    GET  /health      -> فحص صحي سريع للجهاز
=================================================================================
*/

#include <WiFi.h>
#include <WebServer.h>
#include <Wire.h>
#include <Preferences.h>
#include <math.h>

// ─────────────────────────────────────────────────────────────────────────────
// 1) ثوابت الشبكة
// ─────────────────────────────────────────────────────────────────────────────
static const char* DEFAULT_WIFI_SSID = "Ghazi";
static const char* DEFAULT_WIFI_PASS = "012345678";
static const char* AP_SSID           = "ESP32-Compaction";
static const char* AP_PASS           = "12345678";
static const char* API_KEY           = "FMA2026";

// ─────────────────────────────────────────────────────────────────────────────
// 2) أرجل I2C وعنوان الحساس
// ─────────────────────────────────────────────────────────────────────────────
static const int     I2C_SDA_PIN  = 21;
static const int     I2C_SCL_PIN  = 22;
static const uint8_t MPU_ADDR     = 0x68;  // AD0 → GND = 0x68

// ─────────────────────────────────────────────────────────────────────────────
// 3) سجلات MPU-9250/6500/9255
// ─────────────────────────────────────────────────────────────────────────────
static const uint8_t REG_SMPLRT_DIV    = 0x19;
static const uint8_t REG_CONFIG        = 0x1A;
static const uint8_t REG_GYRO_CONFIG   = 0x1B;
static const uint8_t REG_ACCEL_CONFIG  = 0x1C;
static const uint8_t REG_ACCEL_CONFIG2 = 0x1D;
static const uint8_t REG_INT_PIN_CFG   = 0x37;
static const uint8_t REG_ACCEL_XOUT_H  = 0x3B;
static const uint8_t REG_PWR_MGMT_1   = 0x6B;

// ─────────────────────────────────────────────────────────────────────────────
// 4) إعدادات أخذ العينات
// ─────────────────────────────────────────────────────────────────────────────
static const int SAMPLE_COUNT        = 200;   // عدد القراءات لكل إطار
static const int SAMPLE_DELAY_MS     = 5;     // تأخير بين القراءات (ms)
static const int CALIBRATION_SAMPLES = 400;   // عينات المعايرة الأولية

// ─────────────────────────────────────────────────────────────────────────────
// 5) عتبة كشف مرور المدحلة
//    إذا كان RMS > COMPACTION_THRESHOLD  →  يُعتبر أن المدحلة تمر
//    الكشف بالحافة الصاعدة (rising edge) لمنع تعداد متكرر
// ─────────────────────────────────────────────────────────────────────────────
static const float COMPACTION_THRESHOLD = 1.5f;  // g

// ─────────────────────────────────────────────────────────────────────────────
// 6) معاملات الدمك المرجعية
// ─────────────────────────────────────────────────────────────────────────────
static const float REF_INITIAL = 78.0f;   // نسبة الدمك الابتدائية %
static const float REF_FINAL   = 98.5f;   // نسبة الدمك النهائية المرجعية %
static const int   REF_PASSES  = 8;       // عدد التمريرات المرجعية

// ─────────────────────────────────────────────────────────────────────────────
// 7) الكائنات العامة
// ─────────────────────────────────────────────────────────────────────────────
WebServer   server(80);
Preferences prefs;

String activeSSID;
String activePass;

// ─────────────────────────────────────────────────────────────────────────────
// 8) متغيرات الحساس والعداد
// ─────────────────────────────────────────────────────────────────────────────
struct SensorFrame {
  float    ax, ay, az;
  float    gx, gy, gz;
  float    tempC;
  float    rms;
  float    peak;
  float    dominantHz;
  float    gyroRms;
  uint32_t uptimeMs;
};

// متغيرات المعايرة
float accelOffsetX = 0.0f, accelOffsetY = 0.0f, accelOffsetZ = 0.0f;
float gyroOffsetX  = 0.0f, gyroOffsetY  = 0.0f, gyroOffsetZ  = 0.0f;

// عداد التمريرات وكشف الحافة
volatile int  compactionPasses    = 0;
volatile bool prevAboveThreshold  = false;  // حالة الدورة السابقة
volatile bool isTracking          = false;  // وضع التتبع النشط

unsigned long lastSerialMs = 0;
bool hasSavedWifiConfig = false;

// ─────────────────────────────────────────────────────────────────────────────
// 9) واجهة الويب الأصلية مدمجة داخل الكود بشكل مضغوط
//    نفس التصميم الأصلي محفوظ، لكن الصفحة مضغوطة GZIP لتقليل الفلاش والحمل على الربط.
// ─────────────────────────────────────────────────────────────────────────────
static const uint8_t INDEX_HTML_GZ[] PROGMEM = {
  0x1F, 0x8B, 0x08, 0x00, 0x4A, 0xAA, 0x25, 0x6A, 0x02, 0xFF, 0xE5, 0x3D, 0xDB, 0x72, 0x1B, 0xC7,
  0x95, 0xEF, 0xFC, 0x8A, 0x36, 0x54, 0x31, 0x06, 0x36, 0xEE, 0x24, 0x25, 0x12, 0xBC, 0x38, 0x8A,
  0x2E, 0x36, 0x77, 0x45, 0x8B, 0x25, 0x32, 0xEB, 0xCD, 0x2A, 0x2A, 0xD5, 0x00, 0xD3, 0x00, 0x26,
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  0x05, 0x89, 0x36, 0x69, 0x31, 0x7E, 0x65, 0x00, 0x00
};
static const size_t INDEX_HTML_GZ_LEN = 7289;

void clearSavedWifiCredentials() {
  prefs.begin("wifi-cfg", false);
  prefs.remove("wifi_ssid");
  prefs.remove("wifi_pass");
  prefs.end();
  activeSSID = "";
  activePass = "";
  hasSavedWifiConfig = false;
}

// ─────────────────────────────────────────────────────────────────────────────
// 10) إضافة هيدرات CORS
// ─────────────────────────────────────────────────────────────────────────────
void addCorsHeaders() {
  server.sendHeader("Access-Control-Allow-Origin",  "*");
  server.sendHeader("Access-Control-Allow-Methods", "GET, POST, OPTIONS");
  server.sendHeader("Access-Control-Allow-Headers", "Content-Type, X-API-Key");
}

// ─────────────────────────────────────────────────────────────────────────────
// 11) أدوات I2C
// ─────────────────────────────────────────────────────────────────────────────
void writeReg(uint8_t reg, uint8_t value) {
  Wire.beginTransmission(MPU_ADDR);
  Wire.write(reg);
  Wire.write(value);
  Wire.endTransmission(true);
}

bool readRegs(uint8_t reg, uint8_t count, uint8_t* buf) {
  Wire.beginTransmission(MPU_ADDR);
  Wire.write(reg);
  if (Wire.endTransmission(false) != 0) return false;
  uint8_t n = Wire.requestFrom((int)MPU_ADDR, (int)count, (int)true);
  if (n != count) return false;
  for (uint8_t i = 0; i < count; i++) buf[i] = Wire.read();
  return true;
}

bool readRawFrame(int16_t& ax, int16_t& ay, int16_t& az,
                  int16_t& temp, int16_t& gx, int16_t& gy, int16_t& gz) {
  uint8_t raw[14];
  if (!readRegs(REG_ACCEL_XOUT_H, 14, raw)) return false;
  ax   = (int16_t)((raw[0]  << 8) | raw[1]);
  ay   = (int16_t)((raw[2]  << 8) | raw[3]);
  az   = (int16_t)((raw[4]  << 8) | raw[5]);
  temp = (int16_t)((raw[6]  << 8) | raw[7]);
  gx   = (int16_t)((raw[8]  << 8) | raw[9]);
  gy   = (int16_t)((raw[10] << 8) | raw[11]);
  gz   = (int16_t)((raw[12] << 8) | raw[13]);
  return true;
}

// ─────────────────────────────────────────────────────────────────────────────
// 12) كشف وجود الحساس وتهيئته
// ─────────────────────────────────────────────────────────────────────────────
bool sensorExists() {
  Wire.beginTransmission(MPU_ADDR);
  return (Wire.endTransmission() == 0);
}

void initMPU() {
  writeReg(REG_PWR_MGMT_1,   0x00); // تشغيل
  delay(100);
  writeReg(REG_SMPLRT_DIV,   0x04); // ~200 Hz
  writeReg(REG_CONFIG,        0x03); // DLPF
  writeReg(REG_GYRO_CONFIG,   0x08); // ±500 dps
  writeReg(REG_ACCEL_CONFIG,  0x08); // ±4g
  writeReg(REG_ACCEL_CONFIG2, 0x03); // DLPF للتسارع
  writeReg(REG_INT_PIN_CFG,   0x02);
  delay(50);
}

// ─────────────────────────────────────────────────────────────────────────────
// 13) معايرة الإزاحة الصفرية
// ─────────────────────────────────────────────────────────────────────────────
void calibrateSensor(int samples = CALIBRATION_SAMPLES) {
  float sumAx = 0, sumAy = 0, sumAz = 0;
  float sumGx = 0, sumGy = 0, sumGz = 0;
  int   valid = 0;
  Serial.println("[CAL] بدأت المعايرة... ضع الجهاز ثابتاً بدون حركة.");
  for (int i = 0; i < samples; i++) {
    int16_t rax, ray, raz, rt, rgx, rgy, rgz;
    if (readRawFrame(rax, ray, raz, rt, rgx, rgy, rgz)) {
      sumAx += (float)rax / 8192.0f;
      sumAy += (float)ray / 8192.0f;
      sumAz += (float)raz / 8192.0f;
      sumGx += (float)rgx / 65.5f;
      sumGy += (float)rgy / 65.5f;
      sumGz += (float)rgz / 65.5f;
      valid++;
    }
    delay(5);
  }
  if (valid > 0) {
    accelOffsetX = sumAx / valid;
    accelOffsetY = sumAy / valid;
    accelOffsetZ = (sumAz / valid) - 1.0f;  // إزالة الجاذبية من المحور العمودي
    gyroOffsetX  = sumGx / valid;
    gyroOffsetY  = sumGy / valid;
    gyroOffsetZ  = sumGz / valid;
  }
  Serial.println("[CAL] انتهت المعايرة بنجاح.");
  Serial.printf("[CAL] إزاحة التسارع: %.4f, %.4f, %.4f g\n",
                accelOffsetX, accelOffsetY, accelOffsetZ);
  Serial.printf("[CAL] إزاحة الجيروسكوب: %.4f, %.4f, %.4f dps\n",
                gyroOffsetX, gyroOffsetY, gyroOffsetZ);
}

// ─────────────────────────────────────────────────────────────────────────────
// 14) التقاط إطار حساس معالج
//     + كشف التمريرات من الحافة الصاعدة للـ RMS
// ─────────────────────────────────────────────────────────────────────────────
SensorFrame captureFrame() {
  SensorFrame f{};
  float sumDyn2 = 0, sumGyr2 = 0, peak = 0;
  int   crossings = 0;
  float prevDyn = 0;
  bool  hasPrev = false;

  float lastAx = 0, lastAy = 0, lastAz = 1;
  float lastGx = 0, lastGy = 0, lastGz = 0;
  float lastT  = 25;

  for (int i = 0; i < SAMPLE_COUNT; i++) {
    int16_t rax, ray, raz, rt, rgx, rgy, rgz;
    if (readRawFrame(rax, ray, raz, rt, rgx, rgy, rgz)) {
      float ax = (float)rax / 8192.0f - accelOffsetX;
      float ay = (float)ray / 8192.0f - accelOffsetY;
      float az = (float)raz / 8192.0f - accelOffsetZ;
      float gx = (float)rgx / 65.5f   - gyroOffsetX;
      float gy = (float)rgy / 65.5f   - gyroOffsetY;
      float gz = (float)rgz / 65.5f   - gyroOffsetZ;
      float tempC = (float)rt / 333.87f + 21.0f;

      float mag  = sqrtf(ax*ax + ay*ay + az*az);
      float dyn  = mag - 1.0f;
      float gyroMag = sqrtf(gx*gx + gy*gy + gz*gz);

      sumDyn2 += dyn * dyn;
      sumGyr2 += gyroMag * gyroMag;
      if (fabsf(dyn) > peak) peak = fabsf(dyn);

      if (hasPrev && ((dyn >= 0 && prevDyn < 0) || (dyn < 0 && prevDyn >= 0)))
        crossings++;

      prevDyn = dyn; hasPrev = true;
      lastAx = ax; lastAy = ay; lastAz = az;
      lastGx = gx; lastGy = gy; lastGz = gz;
      lastT  = tempC;
    }
    delay(SAMPLE_DELAY_MS);
  }

  float dur = (SAMPLE_COUNT * SAMPLE_DELAY_MS) / 1000.0f;
  f.ax         = lastAx;   f.ay  = lastAy;   f.az  = lastAz;
  f.gx         = lastGx;   f.gy  = lastGy;   f.gz  = lastGz;
  f.tempC      = lastT;
  f.rms        = sqrtf(sumDyn2 / SAMPLE_COUNT);
  f.peak       = peak;
  f.gyroRms    = sqrtf(sumGyr2 / SAMPLE_COUNT);
  f.dominantHz = (crossings / 2.0f) / max(dur, 0.001f);
  f.uptimeMs   = millis();

  // ── كشف تمرير المدحلة بالحافة الصاعدة ──
  bool currentlyAbove = (f.rms > COMPACTION_THRESHOLD);
  if (currentlyAbove && !prevAboveThreshold && isTracking) {
    compactionPasses++;
    Serial.printf("[PASS] تمرير رقم %d  RMS=%.3f\n", compactionPasses, f.rms);
  }
  prevAboveThreshold = currentlyAbove;

  return f;
}

// ─────────────────────────────────────────────────────────────────────────────
// 15) حساب نسبة الدمك
// ─────────────────────────────────────────────────────────────────────────────
float calcCompaction(int passes) {
  float ratio = (REF_PASSES > 0) ? min(1.0f, (float)passes / (float)REF_PASSES) : 0.0f;
  return REF_INITIAL + (REF_FINAL - REF_INITIAL) * ratio;
}

String compStatus(float comp) {
  if (comp < 95.0f)   return "غير مقبول";
  if (comp <= 100.0f) return "مقبول";
  return "دمك مفرط";
}
String compColor(float comp) {
  if (comp < 95.0f)   return "#e74c3c";
  if (comp <= 100.0f) return "#27ae60";
  return "#2980b9";
}

// ─────────────────────────────────────────────────────────────────────────────
// 16) بناء JSON للاستجابة
// ─────────────────────────────────────────────────────────────────────────────
String buildJson(const SensorFrame& f) {
  float comp    = calcCompaction(compactionPasses);
  String status = compStatus(comp);
  String color  = compColor(comp);

  String mode, ssid_str, ip_str;
  if (WiFi.getMode() == WIFI_AP) {
    mode     = "AP";
    ssid_str = String(AP_SSID);
    ip_str   = WiFi.softAPIP().toString();
  } else {
    mode     = "STA";
    ssid_str = WiFi.SSID();
    ip_str   = WiFi.localIP().toString();
  }

  String out;
  out.reserve(640);
  out += "{\"ax\":"; out += String(f.ax, 4);
  out += ",\"ay\":"; out += String(f.ay, 4);
  out += ",\"az\":"; out += String(f.az, 4);
  out += ",\"gx\":"; out += String(f.gx, 3);
  out += ",\"gy\":"; out += String(f.gy, 3);
  out += ",\"gz\":"; out += String(f.gz, 3);
  out += ",\"temp_c\":"; out += String(f.tempC, 2);
  out += ",\"rms\":"; out += String(f.rms, 4);
  out += ",\"peak\":"; out += String(f.peak, 4);
  out += ",\"dominant_hz\":"; out += String(f.dominantHz, 3);
  out += ",\"gyro_rms\":"; out += String(f.gyroRms, 4);
  out += ",\"uptime_ms\":"; out += String(f.uptimeMs);
  out += ",\"passes\":"; out += String(compactionPasses);
  out += ",\"compaction_percent\":"; out += String(comp, 2);
  out += ",\"compaction_status\":\""; out += status; out += "\"";
  out += ",\"point_color\":\""; out += color; out += "\"";
  out += ",\"threshold_g\":"; out += String(COMPACTION_THRESHOLD, 2);
  out += ",\"wifi_mode\":\""; out += mode; out += "\"";
  out += ",\"ssid\":\""; out += ssid_str; out += "\"";
  out += ",\"ip\":\""; out += ip_str; out += "\"";
  out += ",\"tracking\":"; out += (isTracking ? "true" : "false");
  out += ",\"wifi_saved\":"; out += (hasSavedWifiConfig ? "true" : "false");
  out += ",\"free_heap\":"; out += String(ESP.getFreeHeap());
  out += ",\"min_free_heap\":"; out += String(ESP.getMinFreeHeap());
  out += ",\"ap_ssid\":\""; out += String(AP_SSID); out += "\"";
  out += "}";
  return out;
}

// ─────────────────────────────────────────────────────────────────────────────
// 17) معالجات HTTP
// ─────────────────────────────────────────────────────────────────────────────
void handleRoot() {
  addCorsHeaders();
  server.sendHeader("Content-Encoding", "gzip");
  server.send_P(200, "text/html; charset=utf-8", reinterpret_cast<const char*>(INDEX_HTML_GZ), INDEX_HTML_GZ_LEN);
}

void handleData() {
  SensorFrame frame = captureFrame();
  String payload    = buildJson(frame);
  addCorsHeaders();
  server.send(200, "application/json", payload);

  if (millis() - lastSerialMs > 2000) {
    lastSerialMs = millis();
    float comp = calcCompaction(compactionPasses);
    Serial.printf("[DATA] RMS=%.3f Peak=%.3f Hz=%.2f P=%d Comp=%.1f%%\n",
                  frame.rms, frame.peak, frame.dominantHz, compactionPasses, comp);
  }
}

void handleCalibrate() {
  calibrateSensor();
  addCorsHeaders();
  server.send(200, "application/json",
    "{\"status\":\"ok\",\"message\":\"تمت إعادة المعايرة\"}");
}

String jsonEscape(const String& in) {
  String out;
  out.reserve(in.length() + 8);
  for (size_t i = 0; i < in.length(); ++i) {
    char c = in[i];
    if (c == '\\' || c == '"') out += '\\';
    out += c;
  }
  return out;
}

String extractJsonString(const String& body, const String& key) {
  String token = String("\"") + key + "\"";
  int p = body.indexOf(token);
  if (p < 0) return "";
  p = body.indexOf(':', p + token.length());
  if (p < 0) return "";
  ++p;
  while (p < (int)body.length() && isspace((unsigned char)body[p])) ++p;
  if (p >= (int)body.length()) return "";
  if (body[p] == '"') {
    ++p;
    String out;
    while (p < (int)body.length()) {
      char c = body[p++];
      if (c == '\\' && p < (int)body.length()) {
        out += body[p++];
        continue;
      }
      if (c == '"') break;
      out += c;
    }
    return out;
  }
  int e = p;
  while (e < (int)body.length() && body[e] != ',' && body[e] != '}' && !isspace((unsigned char)body[e])) ++e;
  return body.substring(p, e);
}

void handleGetWifi() {
  addCorsHeaders();
  String mode = (WiFi.getMode() == WIFI_AP) ? "AP" : "STA";
  String ip = (WiFi.getMode() == WIFI_AP) ? WiFi.softAPIP().toString() : WiFi.localIP().toString();
  String out = String("{\"ssid\":\"") + jsonEscape(activeSSID)
             + "\",\"mode\":\"" + mode
             + "\",\"ip\":\"" + ip
             + "\",\"saved\":" + (hasSavedWifiConfig ? "true" : "false")
             + ",\"ap_ssid\":\"" + String(AP_SSID) + "\"}";
  server.send(200, "application/json", out);
}

void handleSetWifiOptions() {
  addCorsHeaders();
  server.send(204, "text/plain", "");
}

bool checkApiKey() {
  if (!server.hasHeader("X-API-Key") || server.header("X-API-Key") != String(API_KEY)) {
    server.send(403, "application/json", "{\"status\":\"error\",\"message\":\"مفتاح API غير صحيح\"}");
    return false;
  }
  return true;
}

void handleSetWifi() {
  addCorsHeaders();
  if (!checkApiKey()) {
    Serial.println("[WIFI] رُفض طلب تغيير الشبكة: مفتاح خاطئ.");
    return;
  }
  if (!server.hasArg("plain")) {
    server.send(400, "application/json",
      "{\"status\":\"error\",\"message\":\"لا توجد بيانات JSON\"}");
    return;
  }
  String body = server.arg("plain");
  String newSSID = extractJsonString(body, "ssid");
  String newPass = extractJsonString(body, "password");
  if (newSSID.length() == 0 && body.indexOf("\"ssid\"") >= 0) {
    newSSID = extractJsonString(body, "ssid");
  }
  if (newSSID.length() == 0) {
    server.send(400, "application/json",
      "{\"status\":\"error\",\"message\":\"الحقول ssid/password مفقودة\"}");
    return;
  }
  if (newSSID.length() == 0) {
    server.send(400, "application/json",
      "{\"status\":\"error\",\"message\":\"اسم الشبكة فارغ\"}");
    return;
  }
  prefs.begin("wifi-cfg", false);
  prefs.putString("wifi_ssid", newSSID);
  prefs.putString("wifi_pass", newPass);
  prefs.end();
  activeSSID = newSSID;
  activePass = newPass;
  hasSavedWifiConfig = true;
  Serial.printf("[WIFI] شبكة جديدة محفوظة: %s\n", newSSID.c_str());
  server.send(200, "application/json",
    "{\"status\":\"ok\",\"message\":\"تم الحفظ، جاري إعادة التشغيل...\"}");
  delay(200);
  ESP.restart();
}

void handleResetWifi() {
  addCorsHeaders();
  if (!checkApiKey()) return;
  clearSavedWifiCredentials();
  server.send(200, "application/json",
    "{\"status\":\"ok\",\"message\":\"تم حذف شبكة Wi-Fi المحفوظة، سيعاد التشغيل إلى وضع AP\"}");
  delay(200);
  ESP.restart();
}

void handleReboot() {
  addCorsHeaders();
  if (!checkApiKey()) return;
  server.send(200, "application/json",
    "{\"status\":\"ok\",\"message\":\"تم إرسال أمر إعادة التشغيل\"}");
  delay(200);
  ESP.restart();
}

void handleHealth() {
  addCorsHeaders();
  String mode = (WiFi.getMode() == WIFI_AP) ? "AP" : "STA";
  String ip = (WiFi.getMode() == WIFI_AP) ? WiFi.softAPIP().toString() : WiFi.localIP().toString();
  String out;
  out.reserve(320);
  out += "{\"status\":\"ok\"";
  out += ",\"mode\":\""; out += mode; out += "\"";
  out += ",\"ssid\":\""; out += jsonEscape(activeSSID); out += "\"";
  out += ",\"ip\":\""; out += ip; out += "\"";
  out += ",\"tracking\":"; out += (isTracking ? "true" : "false");
  out += ",\"passes\":"; out += String(compactionPasses);
  out += ",\"wifi_saved\":"; out += (hasSavedWifiConfig ? "true" : "false");
  out += ",\"free_heap\":"; out += String(ESP.getFreeHeap());
  out += ",\"min_free_heap\":"; out += String(ESP.getMinFreeHeap());
  out += ",\"sensor_present\":"; out += (sensorExists() ? "true" : "false");
  out += ",\"uptime_ms\":"; out += String(millis());
  out += "}";
  server.send(200, "application/json", out);
}

void handleControl() {
  addCorsHeaders();
  if (!server.hasArg("plain")) {
    server.send(400, "application/json",
      "{\"status\":\"error\",\"message\":\"لا توجد بيانات\"}");
    return;
  }
  String body = server.arg("plain");
  String action = extractJsonString(body, "action");
  if (action.length() == 0) {
    server.send(400, "application/json",
      "{\"status\":\"error\",\"message\":\"JSON خاطئ\"}");
    return;
  }
  if (action == "start") {
    isTracking = true;
    Serial.println("[CTRL] بدأ التتبع.");
  } else if (action == "stop") {
    isTracking = false;
    Serial.println("[CTRL] توقف التتبع.");
  } else if (action == "clear") {
    compactionPasses   = 0;
    prevAboveThreshold = false;
    isTracking         = false;
    Serial.println("[CTRL] تم المسح وتصفير العداد.");
  }
  String resp = "{\"status\":\"ok\",\"action\":\"" + action
              + "\",\"passes\":" + String(compactionPasses)
              + ",\"tracking\":" + (isTracking ? "true" : "false") + "}";
  server.send(200, "application/json", resp);
}

void handleControlOptions() {
  addCorsHeaders();
  server.send(204, "text/plain", "");
}

void handleNotFound() {
  addCorsHeaders();
  server.send(404, "application/json", "{\"status\":\"error\",\"message\":\"Not Found\"}");
}

// ─────────────────────────────────────────────────────────────────────────────
// 18) إعداد الخادم
// ─────────────────────────────────────────────────────────────────────────────
void setupServer() {
  const char* hdrs[] = {"X-API-Key", "Content-Type"};
  server.collectHeaders(hdrs, 2);

  server.on("/",           HTTP_GET,     handleRoot);
  server.on("/data",       HTTP_GET,     handleData);
  server.on("/health",     HTTP_GET,     handleHealth);
  server.on("/calibrate",  HTTP_GET,     handleCalibrate);
  server.on("/get-wifi",   HTTP_GET,     handleGetWifi);
  server.on("/set-wifi",   HTTP_OPTIONS, handleSetWifiOptions);
  server.on("/set-wifi",   HTTP_POST,    handleSetWifi);
  server.on("/reset-wifi", HTTP_OPTIONS, handleSetWifiOptions);
  server.on("/reset-wifi", HTTP_POST,    handleResetWifi);
  server.on("/reboot",     HTTP_OPTIONS, handleSetWifiOptions);
  server.on("/reboot",     HTTP_POST,    handleReboot);
  server.on("/control",    HTTP_OPTIONS, handleControlOptions);
  server.on("/control",    HTTP_POST,    handleControl);
  server.onNotFound(handleNotFound);

  server.begin();
  Serial.println("[HTTP] الخادم يعمل على المنفذ 80.");
}

// ─────────────────────────────────────────────────────────────────────────────
// 19) تحميل إعدادات Wi-Fi
// ─────────────────────────────────────────────────────────────────────────────
void loadWifiCredentials() {
  prefs.begin("wifi-cfg", true);
  String ss = prefs.getString("wifi_ssid", "");
  String ps = prefs.getString("wifi_pass", "");
  prefs.end();
  if (ss.length() > 0) {
    activeSSID = ss;
    activePass = ps;
    hasSavedWifiConfig = true;
    Serial.printf("[PREFS] تم تحميل الشبكة المحفوظة: %s\n", activeSSID.c_str());
  } else {
    activeSSID = String(DEFAULT_WIFI_SSID);
    activePass = String(DEFAULT_WIFI_PASS);
    hasSavedWifiConfig = false;
    Serial.println("[PREFS] لا توجد شبكة محفوظة، تم استخدام القيم الافتراضية.");
  }
}

// ─────────────────────────────────────────────────────────────────────────────
// 20) إعداد الشبكة
// ─────────────────────────────────────────────────────────────────────────────
void setupWiFi() {
  WiFi.mode(WIFI_STA);
  WiFi.begin(activeSSID.c_str(), activePass.c_str());
  Serial.printf("[WIFI] محاولة الاتصال بـ: %s\n", activeSSID.c_str());

  unsigned long t0 = millis();
  while (WiFi.status() != WL_CONNECTED && millis() - t0 < 12000) {
    delay(500); Serial.print(".");
  }
  Serial.println();

  if (WiFi.status() == WL_CONNECTED) {
    Serial.printf("[WIFI] ✅ متصل | IP: %s\n", WiFi.localIP().toString().c_str());
  } else {
    Serial.println("[WIFI] ❌ فشل الاتصال، تشغيل نقطة وصول AP...");
    WiFi.disconnect(true, true);
    delay(300);
    WiFi.mode(WIFI_AP);
    WiFi.softAP(AP_SSID, AP_PASS);
    Serial.printf("[WIFI] AP جاهز | IP: %s | SSID: %s | Pass: %s\n",
                  WiFi.softAPIP().toString().c_str(), AP_SSID, AP_PASS);
  }
}

// ─────────────────────────────────────────────────────────────────────────────
// 21) setup
// ─────────────────────────────────────────────────────────────────────────────
void setup() {
  Serial.begin(115200);
  delay(1000);
  Serial.println();
  Serial.println("====================================================================");
  Serial.println("  مراقبة دمك التربة FMA - DOIT ESP32 DEVKIT V1 + MPU9250/6500");
  Serial.println("====================================================================");

  loadWifiCredentials();

  Wire.begin(I2C_SDA_PIN, I2C_SCL_PIN);
  Wire.setClock(400000);

  if (!sensorExists()) {
    Serial.println("[ERROR] ❌ لم يُعثر على الحساس عند 0x68.");
    Serial.println("[ERROR] تحقق من توصيلات VCC/GND/SDA/SCL/AD0.");
    while (true) delay(1000);
  }
  Serial.println("[MPU] ✅ تم الكشف عن الحساس MPU-9250/6500.");

  initMPU();
  calibrateSensor();

  Serial.printf("[HTTP] واجهة الويب المدمجة المضغوطة جاهزة (%u bytes gz)\n", (unsigned)INDEX_HTML_GZ_LEN);

  setupWiFi();
  setupServer();

  Serial.println("====================================================================");
  Serial.println("  الجهاز جاهز للاستخدام الميداني.");
  Serial.printf ("  عتبة كشف التمرير: %.2f g\n", COMPACTION_THRESHOLD);
  Serial.printf ("  ref_initial=%.1f%%  ref_final=%.1f%%  ref_passes=%d\n",
                 REF_INITIAL, REF_FINAL, REF_PASSES);
  Serial.println("====================================================================");
}

// ─────────────────────────────────────────────────────────────────────────────
// 22) loop
// ─────────────────────────────────────────────────────────────────────────────
void loop() {
  server.handleClient();
}
